## drivers/lkss/lab1/Kconfig
```kconfig
# SPDX-License-Identifier: GPL-2.0-only

if LKSS_DRIVERS_LAB1

config LKSS_DRIVERS_LAB1_EX1
	tristate "Lab 1 Ex 1 - Hello World"
	help
	  Compile Lab 1 exercise 1 - "Hello World"

config LKSS_DRIVERS_LAB1_EX2
	tristate "Lab 1 Ex 2 - Ooopses and panic"
	help
	  Compile Lab 1 exercise 2 - "Oopses and panic"

config LKSS_DRIVERS_LAB1_EX3
	tristate "Lab 1 Ex 3 - Timer"
	help
	  Compile Lab 1 exercise 3 - "Timers"

config LKSS_DRIVERS_LAB1_EX4
	tristate "Lab 1 Ex 4 - Platform Driver"
	help
	  Compile Lab 1 exercise 4 - "Platform driver"

endif # LKSS_DRIVERS_LAB1
```

## drivers/lkss/lab2/Kconfig
```kconfig
# SPDX-License-Identifier: GPL-2.0-only

if LKSS_DRIVERS_LAB2

config LKSS_DRIVERS_LAB2_EX3
	tristate "Lab2 Ex3 - Character device LED driver using gpiod"
	default n
	help
	  Compile Lab2 Ex3: Character device LED driver using gpiod

config LKSS_DRIVERS_LAB2_EX4
	tristate "Lab2 Ex4 - Character device LED driver with ioctl() commands"
	default n
	help
	  Compile Lab2 Ex4: Character device LED driver
	  using gpiod and ioctl() commands

endif # LKSS_DRIVERS_LAB2
```
